## Kconfig
```kconfig
# zmk-driver-pim447/Kconfig

menuconfig PIM447
    bool "Pimoroni PIM447 trackball driver"
    depends on I2C
    depends on INPUT
    help
      Enable the Pimoroni PIM447 Trackball Breakout driver.

      Supports both interrupt-driven (preferred, requires int-gpios in
      devicetree) and polling fallback modes.

if PIM447

module = PIM447
module-str = pim447
source "subsys/logging/Kconfig.template.log_config"

endif # PIM447
```

## drivers/input/Kconfig
```kconfig
config PIM447
	bool "Pimoroni PIM447 Trackball Breakout driver"
	default y
	depends on DT_HAS_PIMORONI_PIM447_ENABLED
	depends on I2C
	select INPUT
	help
	  Enable driver for the Pimoroni PIM447 I2C trackball breakout.
	  Reports X/Y relative movement and button click as Zephyr input events.

config PIM447_LOG_LEVEL
	int "Log level for PIM447 driver"
	default 0
	depends on PIM447
	range 0 4
```

## dts/bindings/input/pimoroni,pim447.yaml
```yaml
description: |
  Pimoroni PIM447 Trackball Breakout - I2C RGBW-illuminated clickable trackball.

  The driver supports two modes of operation:

    INTERRUPT-DRIVEN (preferred): if int-gpios is defined, the driver uses
    the PIM447's INT line to wake on motion or button activity. CPU is only
    used when there is actual input. Much better for battery life and BLE
    responsiveness on busy systems.

    POLLING (fallback): if int-gpios is not defined, the driver polls at
    poll-interval-ms. Easier to wire (no INT line needed) but uses more CPU.

compatible: "pimoroni,pim447"

include: [i2c-device.yaml]

properties:
  int-gpios:
    type: phandle-array
    description: |
      GPIO connected to the PIM447's INT pad. Open-drain active-low; the
      driver enables an internal pull-up. If this property is set, the
      driver runs in interrupt-driven mode and poll-interval-ms is ignored.

  poll-interval-ms:
    type: int
    default: 15
    description: |
      Polling interval in milliseconds. Used only if int-gpios is not set.

  swap-xy:
    type: boolean
    description: Swap X and Y axes.

  invert-x:
    type: boolean
    description: Invert the X axis.

  invert-y:
    type: boolean
    description: Invert the Y axis.

  base-scale:
    type: int
    default: 16
    description: |
      Linear baseline multiplier, in 1/16ths. base-scale=16 is 1.0x.
      Applies to all reported movement before any acceleration kicks in.

  accel-divisor:
    type: int
    default: 0
    description: |
      Magnitude threshold (in raw counts) above which acceleration kicks in.
      Set to 0 to disable acceleration entirely.

  accel-exponent:
    type: int
    default: 0
    description: |
      Curve aggressiveness. 0 disables. 1 linear additive, 2 quadratic, 3 cubic.

  jitter-threshold:
    type: int
    default: 1
    description: |
      Raw per-axis count (before acceleration) at or below which a read is
      treated as sensor noise and dropped instead of reported. Trackball
      encoders commonly produce single-count blips at rest (dust, vibration,
      thermal settling); reporting these as real input keeps resetting ZMK's
      idle-sleep timer, preventing deep sleep and draining the battery even
      though nothing is actually being touched. Set to 0 to disable.
```
